## boards/shields/zest-interface-ethernet/Kconfig.defconfig
```kconfig
# Copyright (c) 2024 CATIE
# SPDX-License-Identifier: Apache-2.0

if SHIELD_ZEST_INTERFACE_ETHERNET

if NETWORKING

config NET_L2_ETHERNET
	default y

endif # NETWORKING

endif # SHIELD_ZEST_INTERFACE_ETHERNET
```

## boards/shields/zest-interface-ethernet/Kconfig.shield
```kconfig
# Copyright (c) 2024 CATIE
# SPDX-License-Identifier: Apache-2.0

config SHIELD_ZEST_INTERFACE_ETHERNET
	def_bool $(shields_list_contains,zest_interface_ethernet)
	select SPI

config SHIELD_ZEST_INTERFACE_ETHERNET_ALT
	def_bool $(shields_list_contains,zest_interface_ethernet_alt)
	select SPI
```
