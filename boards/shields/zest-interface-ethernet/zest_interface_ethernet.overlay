/*
 * Copyright (c) 2024, CATIE
 * SPDX-License-Identifier: Apache-2.0
 */

#include <zephyr/dt-bindings/gpio/sixtron-header.h>

#define PERIPHERAL_ZEST_INTERFACE_ETHERNET(port) \
	spi_zest_interface_ethernet_##port: &sixtron_connector_##port##_spi {};

#define DRIVERS_ZEST_INTERFACE_ETHERNET(port) \
	&spi_zest_interface_ethernet_##port { \
		enc424j600_zest_interface_ethernet_##port: enc424j600##port@0 { \
			compatible = "microchip,enc424j600"; \
			spi-max-frequency = <14000000>; \
			int-gpios = <&sixtron_connector_##port DIO2 GPIO_ACTIVE_LOW>; \
			status = "okay"; \
			reg = <0>; \
		}; \
	};

#define ZEST_INTERFACE_ETHERNET(port) \
	PERIPHERAL_ZEST_INTERFACE_ETHERNET(port) \
	DRIVERS_ZEST_INTERFACE_ETHERNET(port)
